## boards/arm/theremightbenoise/Kconfig.board
```kconfig
# Copyright (c) 2024 Nordic Semiconductor ASA
# SPDX-License-Identifier: Apache-2.0

config BOARD_THEREMIGHTBENOISE
	bool "ThereMightBeNoise"
	depends on SOC_NRF5340_CPUAPP_QKAA
```

## boards/arm/theremightbenoise/Kconfig.defconfig
```kconfig
# Copyright (c) 2024 Nordic Semiconductor ASA
# SPDX-License-Identifier: Apache-2.0

if BOARD_THEREMIGHTBENOISE

config BOARD
	default "theremightbenoise"



endif
```
